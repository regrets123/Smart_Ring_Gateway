## main/Kconfig.projbuild
```kconfig
menu "Smart Ring Gateway"

config GATEWAY_PROBE_NAME
    string "Exact ring advertised name"
    default "M7083_7904"

config GATEWAY_PROBE_ADDRESS
    string "Optional exact BLE address (AA:BB:CC:DD:EE:FF)"
    default ""

config GATEWAY_PROBE_DATE
    string "Optional UTC probe date (YYYY-MM-DD)"
    default ""

config GATEWAY_PROBE_SET_TIME_UTC
    string "One-shot ring clock setting (YYYY-MM-DDTHH:MM:SSZ; leave empty to disable)"
    default ""

config GATEWAY_WIFI_SSID
    string "Wi-Fi SSID"
    default ""

config GATEWAY_WIFI_PASSWORD
    string "Wi-Fi password"
    default ""

config GATEWAY_MQTT_URI
    string "Existing MQTT broker URI"
    default "mqtts://mqtt.saxedesign.se:8883"
    help
        Match the hostname and port of your existing Mosquitto listener.
        For mqtts://, certificate verification uses certs/mqtt_ca.pem.

config GATEWAY_MQTT_USERNAME
    string "MQTT username"
    default ""

config GATEWAY_MQTT_PASSWORD
    string "MQTT password"
    default ""

config GATEWAY_MQTT_TOPIC
    string "MQTT publish topic"
    default "gateway/readings"

config GATEWAY_DEVICE_ID
    string "Device ID"
    default "ring-01"

config GATEWAY_GATEWAY_ID
    string "Gateway ID / MQTT client ID"
    default "gateway-01"

config GATEWAY_USER_ID
    string "User ID"
    default "user-01"

endmenu
```

## sdkconfig.defaults
```kconfig
CONFIG_IDF_TARGET="esp32c3"
CONFIG_ESPTOOLPY_FLASHSIZE_4MB=y
CONFIG_MBEDTLS_CERTIFICATE_BUNDLE=y
```
